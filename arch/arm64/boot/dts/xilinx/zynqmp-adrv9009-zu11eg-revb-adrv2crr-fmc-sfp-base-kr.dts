// SPDX-License-Identifier: GPL-2.0
/*
 * dts file for ADRV2CRR-FMC using ADRV9009-ZU11EG Rev.B System on Module
 *
 * Copyright (C) 2019 Analog Devices Inc.
 *
 */

#include "zynqmp-adrv9009-zu11eg-revb-adrv2crr-fmc.dts"
#include "adi-zu11eg-sfp-base-r.dtsi"
